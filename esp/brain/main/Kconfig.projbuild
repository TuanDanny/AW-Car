## esp/brain/main/Kconfig.projbuild
```kconfig
menu "AW-Car Brain simplev1 (fixed hardware)"
config OTA_URL
    string "Xiaozhi activation/configuration endpoint"
    default "https://api.tenclass.net/xiaozhi/ota/"
config USE_AUDIO_PROCESSOR
    bool "Stock ESP-SR audio processing"
    default y
config USE_DEVICE_AEC
    bool
    default n
config USE_SERVER_AEC
    bool
    default n
config SEND_WAKE_WORD_DATA
    bool
    default n
config WAKE_WORD_DETECTION_IN_LISTENING
    bool
    default n
config USE_AUDIO_DEBUGGER
    bool
    default n
config AUDIO_DEBUG_UDP_SERVER
    string
    default ""
endmenu
```

## esp/motion/sdkconfig.defaults
```kconfig
CONFIG_IDF_TARGET="esp32s3"
CONFIG_ESPTOOLPY_FLASHSIZE_16MB=y
CONFIG_ESPTOOLPY_FLASHMODE_DIO=y
CONFIG_ESPTOOLPY_FLASHFREQ_80M=y
CONFIG_PARTITION_TABLE_CUSTOM=y
CONFIG_PARTITION_TABLE_CUSTOM_FILENAME="partitions.csv"
CONFIG_ESP_DEFAULT_CPU_FREQ_MHZ_240=y
CONFIG_FREERTOS_HZ=1000
CONFIG_COMPILER_OPTIMIZATION_PERF=y
CONFIG_ESP_CONSOLE_UART_DEFAULT=y
CONFIG_ESP_CONSOLE_UART_BAUDRATE=115200
CONFIG_HTTPD_WS_SUPPORT=y
CONFIG_HTTPD_WS_PRE_HANDSHAKE_CB_SUPPORT=y
CONFIG_HTTPD_WS_POST_HANDSHAKE_CB_SUPPORT=y
CONFIG_ESP_TASK_WDT_EN=y
CONFIG_ESP_TASK_WDT_TIMEOUT_S=5
# CONFIG_SPIRAM is not set
```

## firmware/motion/main/Kconfig.projbuild
```kconfig
menu "AW-Car Motion"
config AWCAR_ENABLE_DRIVER
    bool "Allow verified hardware to ARM (default disabled)"
    default n
    help
        Enable only after verifying the separate default-off hardware gate,
        E-stop, pin assignment, driver current and encoder calibration.
        The saved configuration must also have validated=1. This switch never
        bypasses GPIO, session, status freshness, lease or ARM checks.
config AWCAR_BRAIN_TX
    int "UART1 TX to Brain RX"
    default 13
config AWCAR_BRAIN_RX
    int "UART1 RX from Brain TX"
    default 14
config AWCAR_FPGA_TX
    int "UART2 TX to FPGA RX"
    default 15
config AWCAR_FPGA_RX
    int "UART2 RX from FPGA TX"
    default 16
config AWCAR_MOTION_PERMIT
    int "Logical motion_permit to FPGA"
    default 4
config AWCAR_RECOVERY_REQ
    int "Recovery request to FPGA"
    default 5
config AWCAR_RECOVERY_ACK
    int "Recovery acknowledgement from FPGA"
    default 6
config AWCAR_FPGA_PERMIT
    int "Permit feedback from FPGA"
    default 7
config AWCAR_SAFETY_OK
    int "E-stop/power safety OK input, HIGH=healthy"
    default 8
config AWCAR_GATE_OK
    int "External latch gate_fault_n input, HIGH=healthy"
    default 9
config AWCAR_DRIVER_PERMIT
    int "Separate default-LOW permit to hardware driver gate"
    default 10
endmenu
```

## firmware/motion/sdkconfig.defaults
```kconfig
CONFIG_IDF_TARGET="esp32s3"
CONFIG_ESPTOOLPY_FLASHSIZE_16MB=y
CONFIG_ESPTOOLPY_FLASHMODE_DIO=y
CONFIG_ESPTOOLPY_FLASHFREQ_80M=y
CONFIG_PARTITION_TABLE_CUSTOM=y
CONFIG_PARTITION_TABLE_CUSTOM_FILENAME="partitions.csv"
CONFIG_ESP_DEFAULT_CPU_FREQ_MHZ_240=y
CONFIG_FREERTOS_HZ=1000
CONFIG_COMPILER_OPTIMIZATION_PERF=y
CONFIG_ESP_CONSOLE_UART_DEFAULT=y
CONFIG_ESP_CONSOLE_UART_BAUDRATE=115200
CONFIG_GPIO_CTRL_FUNC_IN_IRAM=y
CONFIG_GPTIMER_ISR_IRAM_SAFE=y
CONFIG_ESP_TASK_WDT_EN=y
CONFIG_ESP_TASK_WDT_INIT=y
CONFIG_ESP_TASK_WDT_PANIC=y
CONFIG_ESP_TASK_WDT_TIMEOUT_S=2
# CONFIG_SPIRAM is not set
# CONFIG_AWCAR_ENABLE_DRIVER is not set

# Current Motion board: GPIO17/18 are electrically shorted; leave unused.
CONFIG_AWCAR_BRAIN_TX=13
CONFIG_AWCAR_BRAIN_RX=14
CONFIG_AWCAR_STATUS_LED_GPIO=48
```
