## esp/motion/main/Kconfig.projbuild
```kconfig
menu "AW-Car experimental startup"
    config SIMPLE_STARTUP_ENABLED
        bool "Enable uncalibrated exponential startup envelope"
        default n
        help
            Experimental; disabled for the accepted prototype flow. Measure
            motor current, breakaway and sustainable effort before enabling.
            STOP, release, timeout and reverse/wake guards still take priority.

    config SIMPLE_STARTUP_GAIN_PERCENT
        int "Startup common duty gain (100 = no boost)"
        range 100 300
        default 100
        depends on SIMPLE_STARTUP_ENABLED
        help
            Shared multiplier preserves the requested wheel-effort ratio.
            100 intentionally has no boost; no TT calibration value is assumed.

    config SIMPLE_STARTUP_TAU_MS
        int "Startup exponential time constant (ms)"
        range 10 1000
        default 100
        depends on SIMPLE_STARTUP_ENABLED
endmenu
```

## esp/motion/sdkconfig.defaults
```kconfig
CONFIG_IDF_TARGET="esp32s3"
CONFIG_ESPTOOLPY_FLASHSIZE_16MB=y
CONFIG_ESPTOOLPY_FLASHMODE_DIO=y
CONFIG_ESPTOOLPY_FLASHFREQ_80M=y
CONFIG_PARTITION_TABLE_CUSTOM=y
CONFIG_PARTITION_TABLE_CUSTOM_FILENAME="partitions.csv"
CONFIG_ESP_DEFAULT_CPU_FREQ_MHZ_240=y
CONFIG_FREERTOS_HZ=1000
CONFIG_COMPILER_OPTIMIZATION_PERF=y
CONFIG_ESP_CONSOLE_UART_DEFAULT=y
CONFIG_ESP_CONSOLE_UART_BAUDRATE=115200
CONFIG_HTTPD_WS_SUPPORT=y
CONFIG_HTTPD_WS_PRE_HANDSHAKE_CB_SUPPORT=y
CONFIG_HTTPD_WS_POST_HANDSHAKE_CB_SUPPORT=y
CONFIG_ESP_TASK_WDT_EN=y
CONFIG_ESP_TASK_WDT_TIMEOUT_S=5
CONFIG_VL53L0X_I2C_TIMEOUT_MS=40
CONFIG_VL53L0X_POLLING_DELAY_MS=10
CONFIG_BOOTLOADER_APP_ROLLBACK_ENABLE=y
# CONFIG_SPIRAM is not set
CONFIG_SIMPLE_STARTUP_ENABLED=y
CONFIG_SIMPLE_STARTUP_GAIN_PERCENT=140
CONFIG_SIMPLE_STARTUP_TAU_MS=150
```
